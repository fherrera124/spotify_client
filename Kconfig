## Kconfig
```kconfig
menu "Spotify Client Configuration"

    config DISCORD_TOKEN
        int "Discord Token"
        help
        	The token associated to your Discord account. TODO: add steps to obtain it.
        	
    config SPOTIFY_UID
        int "Spotify UID"
        help
        	The user ID of your Spotify account. TODO: add steps to obtain it.

endmenu
```
